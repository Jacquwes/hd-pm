/*
 * Copyright (c) 2022 The ZMK Contributors
 *
 * SPDX-License-Identifier: MIT
 */

#include <behaviors.dtsi>
#include <dt-bindings/zmk/keys.h>
#include <dt-bindings/zmk/bt.h>
#include <dt-bindings/zmk/outputs.h>
#include <behaviors/num_word.dtsi>      // urob's num_word module


#include "moutis/moutis_config.dtsi"    // my add-on feature defs

#include "keymaps/keynames_3x5_3.h"     // key name defs for this board topology
#include "layouts/hd/vfj-config.h"      // HD alpha keymap, adapt, and combo definitions

&kscan0 {
    debounce-press-ms = <7>;
    debounce-release-ms = <7>;
    debounce-scan-period-ms = <3>;
};

/ {
  chosen {
    zmk,matrix_transform = &saegewerk_transform;
  };
};
/*
 * Behaviors
 */
    behaviors {

#include "moutis/moutis_behaviors.dtsi" // common behaviors (hold-taps, mod-morphs, lingers, adaptives)
#include HD_adapt_file                  // HDalpha/mnemonic based adaptives (most of them)

    };

/*
 * Macros
 */
    macros {
    
#include "moutis/moutis_macros.dtsi"    // common macros (superset)

    };

/*
 * Combos
 */
    combos {
        compatible = "zmk,combos";

#include "moutis/moutis_combos.dtsi"    // common/location based combos (cut/copy/paste, esc, app, etc.)
#include HD_combo_file                  // HD alpha/mnemonic based combos (h-digraphs, etc.)

    };
/*
 * Keymap (all layers w/references to all the above)
 */

#include "keymaps/keymap_3x5_3.dtsi"    // consolidated keymap

};
